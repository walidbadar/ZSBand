## boards/xiaomi/mi_band_4/Kconfig.defconfig
```kconfig
# Copyright (c) 2024 Renesas Electronics Corporation
# Copyright (c) 2026 Muhammad Waleed Badar
# SPDX-License-Identifier: Apache-2.0

if BOARD_MI_BAND_4

config I2C_CALLBACK
	default y if I2C_SMARTBOND

if PM || PM_DEVICE || PM_DEVICE_RUNTIME

# Increase stack size to avoid raising usage-fault
# exceptions due to stack overflow.
config IDLE_STACK_SIZE
	default 2048

# Make sure the serial device has higher
# initialization priority.
config SERIAL_INIT_PRIORITY
	default KERNEL_INIT_PRIORITY_DEFAULT

endif # PM || PM_DEVICE

if BT

config BT_WAIT_NOP
	default y

config TEST_RANDOM_GENERATOR
	default y

endif # BT

if DISPLAY

config LV_COLOR_16_SWAP
	default y if LVGL

endif # DISPLAY

endif # BOARD_MI_BAND_4
```

## boards/xiaomi/mi_band_4/mi_band_4_defconfig
```kconfig
# SPDX-License-Identifier: Apache-2.0

# Enable MPU
CONFIG_ARM_MPU=y

# Enable HW stack protection
CONFIG_HW_STACK_PROTECTION=y

# Enable console over segger RTT
CONFIG_USE_SEGGER_RTT=y
CONFIG_RTT_CONSOLE=y
CONFIG_CONSOLE=y

# Enable GPIO
CONFIG_GPIO=y

# Enable UART
CONFIG_SERIAL=y

# Disable Hex build
CONFIG_BUILD_OUTPUT_HEX=n
```

## boards/xiaomi/mi_band_6/Kconfig.mi_band_6
```kconfig
# Copyright (c) 2026 Muhammad Waleed Badar
# SPDX-License-Identifier: Apache-2.0

config BOARD_MI_BAND_6
	select SOC_DA14697
```

## boards/xiaomi/mi_band_6/board.yml
```yaml
board:
  name: mi_band_6
  full_name: Xiaomi Mi Band 6
  vendor: xiaomi
  socs:
  - name: da14697
```

## drivers/Kconfig
```kconfig
menu "Drivers"
rsource "display/Kconfig.rm69xxx"
rsource "sensor/Kconfig"
endmenu
```

## drivers/display/Kconfig.rm69310
```kconfig
# Copyright (c) 2026 Muhammad Waleed Badar
# SPDX-License-Identifier: Apache-2.0

config RM69310
	bool "Raydium RM69310 display driver"
	default y
	depends on DT_HAS_RAYDIUM_RM69310_ENABLED
	select MIPI_DBI
	help
	  Enable driver for RM69310 display driver.
```

## drivers/display/Kconfig.rm69xxx
```kconfig
# Copyright (c) 2026 Muhammad Waleed Badar
# SPDX-License-Identifier: Apache-2.0

config RM69XXX
	bool "Raydium RM69xxx display driver"
	default y
	depends on DT_HAS_RAYDIUM_RM69310_ENABLED || DT_HAS_RAYDIUM_RM69092_ENABLED
	select MIPI_DBI
	help
	  Enable driver for RM69310 and RM69092 display controllers.
```

## drivers/sensor/Kconfig
```kconfig
# Copyright (c) 2026 Muhammad Waleed Badar
# SPDX-License-Identifier: Apache-2.0

if SENSOR

rsource "iqs620a/Kconfig"

endif # SENSOR
```

## drivers/sensor/afe4900/Kconfig
```kconfig
# Copyright (c) 2026 Muhammad Waleed Badar
# SPDX-License-Identifier: Apache-2.0

config AFE4900
	bool "TI AFE4900 optical bio-sensing front end"
	default y
	depends on DT_HAS_TI_AFE4900_ENABLED
	select I2C
	help
	  Enable driver for the Texas Instruments AFE4900 PPG front end.
```

## drivers/sensor/iqs620a/Kconfig
```kconfig
# Copyright (c) 2026 Muhammad Waleed Badar
# SPDX-License-Identifier: Apache-2.0

config IQS620A
	bool "Azoteq IQS620A ProxFusion sensor"
	default y
	depends on DT_HAS_AZOTEQ_IQS620A_ENABLED
	select I2C
	help
	  Enable driver for the Azoteq IQS620A capacitive, Hall-effect and
	  temperature sensor.
```

## dts/bindings/display/raydium,rm69092.yaml
```yaml
#
# Copyright (c) 2026 Muhammad Waleed Badar
#
# SPDX-License-Identifier: Apache-2.0
#

title: Raydium RM69092 display controller

description: |
  The Raydium RM69092 is a 16.7M colors OLED controller
  with a maximum 480RGBx480 resolution.

compatible: "raydium,rm69092"

include: raydium,rm69xxx-common.yaml
```

## dts/bindings/display/raydium,rm69310.yaml
```yaml
#
# Copyright (c) 2026 Muhammad Waleed Badar
#
# SPDX-License-Identifier: Apache-2.0
#

title: Raydium RM69310 display controller

description: |
  The Raydium RM69310 is a 16.7M colors OLED controller
  with a maximum 240RGBX240 resolution.

compatible: "raydium,rm69310"

include: raydium,rm69xxx-common.yaml
```

## dts/bindings/display/raydium,rm69xxx-common.yaml
```yaml
#
# Copyright (c) 2026 Muhammad Waleed Badar
#
# SPDX-License-Identifier: Apache-2.0
#

description: Common properties for Raydium RM69xxx display controllers.

include: [display-controller.yaml, mipi-dbi-spi-device.yaml]

properties:
  pixel-format:
    type: int
    required: true
    description: |
      Initial Pixel format of this controller's output data.
    enum:
      - 1 # PANEL_PIXEL_FORMAT_RGB_888
      - 16 # PANEL_PIXEL_FORMAT_RGB_565

  x-offset:
    type: int
    default: 0
    description: |
      Horizontal offset of the active area within the controller's
      frame buffer. Needed when the panel's active area does not start
      at column 0 of the controller address space.

  y-offset:
    type: int
    default: 0
    description: |
      Vertical offset of the active area within the controller's
      frame buffer.

  inversion:
    type: boolean
    description: |
      Enable display colour inversion (INVON). Some panel assemblies
      ship with the OLED stack arranged so that colour inversion is
      required to produce a correct image.
```

## dts/bindings/sensor/azoteq,iqs620a.yaml
```yaml
#
# Copyright (c) 2026 Muhammad Waleed Badar
#
# SPDX-License-Identifier: Apache-2.0
#

title: Azoteq IQS620A ProxFusion sensor

description: |
  The Azoteq IQS620A combines capacitive proximity/touch, Hall-effect
  and temperature sensing, and is accessed over I2C.

  Example:

  &i2c {
      iqs620a: iqs620a@44 {
          compatible = "azoteq,iqs620a";
          reg = <0x44>;
      };
  };

compatible: "azoteq,iqs620a"

include: [sensor-device.yaml, i2c-device.yaml]

properties:
  init-regs:
    type: uint8-array
    description: |
      Register address/value pairs written during initialization, before
      the reset is acknowledged and ATI is performed. Use this to apply
      board specific tuning, for example settings exported from the
      Azoteq PC software. Registers not listed keep their reset defaults.

      init-regs = [60 10 61 20];  /* Ch0 prox and touch thresholds */
```

## dts/bindings/sensor/ti,afe4900.yaml
```yaml
#
# Copyright (c) 2026 Muhammad Waleed Badar
#
# SPDX-License-Identifier: Apache-2.0
#

title: Texas Instruments AFE4900 optical bio-sensing front end

description: |
  The AFE4900 drives up to four LEDs and digitizes the photodiode current
  for PPG measurements. The driver uses the I2C interface and the internal
  128 kHz oscillator, and samples LED1, LED2, LED3 and ambient phases.

  Example:

  &i2c {
      afe4900: afe4900@5b {
          compatible = "ti,afe4900";
          reg = <0x5b>;
          sample-rate-hz = <100>;
          led-current-microamp = <10000 0 0>;
      };
  };

compatible: "ti,afe4900"

include: [sensor-device.yaml, i2c-device.yaml]

properties:
  reset-gpios:
    type: phandle-array
    description: |
      RESETZ pin. If present, the device is reset with a pulse on this pin,
      otherwise with the SW_RESET bit.

  sample-rate-hz:
    type: int
    default: 100
    description: Pulse repetition frequency, between 1 and 500 Hz.

  tia-gain-ohms:
    type: int
    default: 100000
    enum:
      - 10000
      - 25000
      - 50000
      - 100000
      - 250000
      - 500000
      - 1000000
      - 1500000
      - 2000000
    description: TIA feedback resistance (RF) applied to all phases.

  led-current-microamp:
    type: array
    default: [0, 0, 0]
    description: |
      Drive current of LED1, LED2 and LED3 in microamps, 0 to 50000.
      All LEDs are off by default.
```

## west.yml
```yaml
# SPDX-License-Identifier: Apache-2.0

manifest:
  remotes:
    - name: zephyrproject-rtos
      url-base: https://github.com/zephyrproject-rtos

  projects:
    - name: zephyr
      remote: zephyrproject-rtos
      revision: main
      import:
        # By using name-allowlist we can clone only the modules that are
        # strictly needed by the application.
        name-allowlist:
          - picolibc
          - mbedtls
          - mcuboot
          - net-tools
          - segger
          - cmsis
          - cmsis_6
          - lvgl
          - hal_renesas

    - name: tf-psa-crypto
      url: https://github.com/TrustedFirmware-M/TF-PSA-Crypto.git
      revision: 765af96a20a2b408474dcd950372ba9af4d26b62
      path: modules/crypto/tf-psa-crypto
```
