## boards/xiaomi/mi_band_4/Kconfig.mi_band_4
```kconfig
# Copyright (c) 2025 Muhammad Waleed Badar
# SPDX-License-Identifier: Apache-2.0

config BOARD_MI_BAND_4
	select SOC_DA14697
```

## boards/xiaomi/mi_band_4/board.yml
```yaml
board:
  name: mi_band_4
  full_name: Xiaomi Mi Band 4
  vendor: xiaomi
  socs:
  - name: da14697
```
